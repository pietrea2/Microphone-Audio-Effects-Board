#include "stdint.h"
#include "defines.h"
#include "interrupt_ID.h"
#include "address_map_arm.h"
#include "sin_LUT.h"
#include "string.h"

#define AUDIO_BUF_SIZE (24000)
#define SAMPLE_RATE (8000)

#if 0
#define TEST_AUDIO_SIZE (3994)
// ding sound at 8k samples/s
static const int test_audio_8khz[] =
{
    0x00000000, 0x00000000, 0xFFFE0001, 0xFFFE0002, 0x00000001, 0xFFFD0001, 0xFFFE0003, 0x00000001, 0x0001FFFF, 0x00000000, 0x00000000, 0x0002FFFF, 0x0003FFFE, 0x0002FFFD, 0x0002FFFE, 0x0002FFFE, 0xFFFFFFFF, 0xFFFC0003, 0xFFFF0003, 0x00000000, 0xFFFE0001, 0xFFFE0002, 0xFFFF0002, 0x00000000, 0x0002FFFF,
    0x0002FFFE, 0x0001FFFE, 0xFFFE0001, 0xFFFE0002, 0xFFFE0002, 0xFFFC0003, 0xFFFD0004, 0x00010001, 0x0002FFFE, 0x0000FFFF, 0x00010000, 0x0003FFFE, 0x0002FFFD, 0x0001FFFF, 0x0000FFFF, 0xFFFF0001, 0xFFFF0001, 0x00010000, 0x0001FFFF, 0x0001FFFF, 0x0002FFFE, 0xFFFE0000, 0xFFFC0003, 0xFFFD0004, 0xFFFF0002,
    0x00010000, 0x0003FFFE, 0x0002FFFD, 0x0001FFFF, 0x0000FFFF, 0xFFFF0001, 0xFFFF0001, 0x00010000, 0x0001FFFF, 0x0001FFFF, 0x0001FFFF, 0x0003FFFE, 0x0002FFFD, 0xFFFE0000, 0xFFFD0003, 0xFFFD0003, 0xFFFB0004, 0xFFFE0004, 0xFFFF0001, 0x00010000, 0x0001FFFF, 0xFFFFFFFF, 0xFFFE0003, 0xFFFF0001, 0x00010000,
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    0x069DF787, 0xF9DBFF84, 0xF9160731, 0x059DFF4A, 0x0526F82D, 0xF8A9015E, 0xFB5E06E5, 0x070BFCF2, 0x02F0F84B, 0xF7B402DD, 0xFD3505D5, 0x07ABFB79, 0x017FF940, 0xF7610410, 0xFF590550, 0x0835FA0E, 0xFF82FAE1, 0xF74604F7, 0x024302FA
};
#endif

typedef enum e_effect
{
    EFF_DEFAULT,
    EFF_PITCH,
    EFF_TREMELO,
    EFF_DELAY,
    EFF_LOOP
}
effect_t;

static volatile int effect;
static volatile int iaudiobuf;
static volatile int lut_counter;
static volatile int freq_mult;
static volatile int left_buffer[AUDIO_BUF_SIZE] = {0};
static volatile int right_buffer[AUDIO_BUF_SIZE] = {0};
static volatile int left_delay_buffer[AUDIO_BUF_SIZE] = {0};
static volatile int right_delay_buffer[AUDIO_BUF_SIZE] = {0};



void config_audio_demo(void)
{
    volatile int* audio_ptr = (int*)AUDIO_BASE;
    volatile int* KEY_ptr = (int*)KEY_BASE;

    volatile int* hex30_ptr = (int*)HEX3_HEX0_BASE;
    volatile int* hex54_ptr = (int*)HEX5_HEX4_BASE;
    *hex54_ptr = ~0x00002106;
    *hex30_ptr = ~0x0EFFFFFF;

    config_interrupt(KEYS_IRQ, CPU0);
    config_interrupt(AUDIO_IRQ, CPU0);

    // enable audio interrupts
    *audio_ptr = 0x3;
    // enable all KEY interrupts
    *(KEY_ptr + 2) = 0xF;

    iaudiobuf = 0;
    freq_mult = 1;
    lut_counter = 0;
    effect = EFF_DEFAULT;
}


void keys_ISR(void)
{
    disable_irq();

    volatile int* key_ptr = (int*)KEY_BASE;
    volatile int* hex30_ptr = (int*)HEX3_HEX0_BASE;
    volatile int* hex54_ptr = (int*)HEX5_HEX4_BASE;

    int press = *(key_ptr + 3);
    *(key_ptr + 3) = press;

    if (press & 0x1)
    {
        if (freq_mult < 5)

            *hex30_ptr = ~0xFFFF0979; //HI
            freq_mult++;
    }
    else if (press & 0x2){
        *hex30_ptr = ~0xFFFF4723; //LO
        freq_mult--;
    }
    else if (press & 0x4){
      

    }
    else{
        if (effect == EFF_LOOP)
            effect = EFF_DEFAULT;
        else
            effect++;

        freq_mult = 1;
        lut_counter = 0;
    }



    if(effect == EFF_DEFAULT){ //dEF
        *hex54_ptr = ~0x00002106;
        *hex30_ptr |= ~0x0EFFFFFF;
    }
    else if(effect == EFF_PITCH){ //Pch
        *hex54_ptr = ~0x00000C27;
        *hex30_ptr |= ~0x0BFFFFFF;
    }
    else if(effect == EFF_TREMELO){ //TRE
        *hex54_ptr = ~0x00007808;
        *hex30_ptr |= ~0x06FFFFFF;
    }
    else if(effect == EFF_DELAY){ //dEL
        *hex54_ptr = ~0x00002106;
        *hex30_ptr |= ~0x47FFFFFF;
    }
    else if(effect == EFF_LOOP){ //LOOP
        *hex54_ptr = ~0x00004740;
        *hex30_ptr |= ~0x400CFFFF;
    }

    enable_irq();
    return;
}


int lowpass(int input)
{
    static int last_sample = 0;
    signed int retvalue = (input + (last_sample * 7)) >> 3;
    last_sample = retvalue;
    return retvalue;
}


void audio_ISR(void)
{
    disable_irq();

	volatile int* audio_ptr = (int *)AUDIO_BASE;

	int fifospace;

	if (*(audio_ptr) & 0x100) // check read interrupt
	{  
		fifospace = *(audio_ptr + 1);
		// read until buffer is full or audio-in FIFO is empty

        if(effect == EFF_DELAY){

            while ((fifospace & 0x000000FF) && (iaudiobuf < AUDIO_BUF_SIZE))
		    {
                int left = *(audio_ptr + 2);
                int right = *(audio_ptr + 3);

                //add delay now to current read audio
                if(iaudiobuf >= 8000){

                    left_buffer[iaudiobuf] = left_delay_buffer[iaudiobuf - 8000];
                    right_buffer[iaudiobuf] = right_delay_buffer[iaudiobuf - 8000];

                    left_delay_buffer[iaudiobuf] = left;
                    right_delay_buffer[iaudiobuf] = right;
                }
                //read audio up to N samples
                else{
                    left_buffer[iaudiobuf] = left;
                    right_buffer[iaudiobuf] = right;

                    left_delay_buffer[iaudiobuf] = left;
                    right_delay_buffer[iaudiobuf] = right;
                }
                
                ++iaudiobuf;
                fifospace = *(audio_ptr + 1);
		    }

            //clear delay buffers
            int i;
            for(i=0; i < AUDIO_BUF_SIZE; i++){
                left_delay_buffer[i] = 0;
                right_delay_buffer[i] = 0;
            }
            
            

        }
        else{
            while ((fifospace & 0x000000FF) && (iaudiobuf < AUDIO_BUF_SIZE))
		    {
                int left = *(audio_ptr + 2);
                int right = *(audio_ptr + 3);
                
                switch(effect)
                {
                    case EFF_DEFAULT:
                    case EFF_PITCH:
                    left_buffer[iaudiobuf] = left;
                    right_buffer[iaudiobuf] = right;
                    ++iaudiobuf;
                    break;

                    case EFF_TREMELO:
                    left_buffer[iaudiobuf] = (int32_t)((left * (int64_t)sin_LUT[lut_counter]) >> 30);
                    right_buffer[iaudiobuf] = (int32_t)((right * (int64_t)sin_LUT[lut_counter]) >> 30);
                    lut_counter += freq_mult;
                    if (lut_counter >= SAMPLE_RATE) 
                        lut_counter = 0;

                    ++iaudiobuf;
                    break;
                }
            
                fifospace = *(audio_ptr + 1);
            }
        }
		
	}
	if (*(audio_ptr) & 0x200) // check write interrupt
	{
		fifospace = *(audio_ptr + 1);
		// output until buffer is empty or audio-out FIFO is full
		while ((fifospace & 0x00FF0000) && (iaudiobuf > 0))
		{
            *(audio_ptr + 2) = left_buffer[iaudiobuf];
            *(audio_ptr + 3) = right_buffer[iaudiobuf];

            if (effect == EFF_PITCH)
                iaudiobuf -= freq_mult;
            else --iaudiobuf;

			fifospace = *(audio_ptr + 1);
		}
	}

    enable_irq();
	return;
}
